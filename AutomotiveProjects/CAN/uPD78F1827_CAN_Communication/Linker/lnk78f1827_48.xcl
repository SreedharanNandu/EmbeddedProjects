//-------------------------------------------------------------------------
//      XLINK command file template for 78K0R microcontroller uPD78F1827_48.
//
//      This filecan be used to link object files from the 78K0R
//      Assembler, A78K0R, and the C/C++ compiler ICC78K0R.
//
//          This file is generated from the device file:
//          DF182748.78K
//          Copyright (C) NEC Corporation 2009
//          Format version V3.00, File version V1.01
//-------------------------------------------------------------------------

//-------------------------------------------------------------------------
//      The following segments are defined in this template link file:
//
//      INTVEC      -- Interrupt vectors.
//      CLTVEC      -- Calltable vectors.
//      RCODE       -- Code used by C/C++ startup and run-time library.
//      CODE        -- Code used by __non_banked, __interrupt and __callt functions.
//      XCODE       -- Code used by __far_func functions.
//      NEAR_CONST_ -- Constants used by __near const.
//      FAR_CONST   -- Constants used by __far const.
//      SADDR_x     -- Variables used by __saddr.
//      NEAR_x      -- Variables used by __near.
//      FAR_x       -- Variables used by __far.
//      NEAR_HEAP   -- The heap used by near data model.
//      FAR_HEAP    -- The heap used by far data model.
//      SWITCH      -- Switch tables used by near code model.
//      FSWITCH     -- Switch tables used by near far model.
//      DIFUNCT     -- Dynamic initialization vector used by C++
//
//      Where _x could be one of:
//
//      _Z      -- Initialized data (initvalue = 0 or without init value).
//      _I      -- Initialized data (initvalue != 0).
//      _ID     -- The inial values of _I.
//      _N      -- Uninitialized data, used by __no_init.
//-------------------------------------------------------------------------

//-------------------------------------------------------------------------
//      Define CPU
//-------------------------------------------------------------------------

-c78000

//-------------------------------------------------------------------------
//      Size of the stack.
//      Remove comment and modify number if used from command line.
//-------------------------------------------------------------------------
//-D_CSTACK_SIZE=80

//-------------------------------------------------------------------------
// 		User defined symbols
//-------------------------------------------------------------------------
-D_RAM_START=FE700
-D_RAM_END=FFEDF
-D_CODE_FLASH_START=000000
-D_CODE_FLASH_END=17FFF

//-------------------------------------------------------------------------
//      Near constant location.
//      0 -> Mirrored in rom area 0x00000 - 0x0FFFF
//      1 -> Mirrored in rom area 0x10000 - 0x1FFFF
//      2 -> Writeable constants
//      Remove comments and modify number if used from command line.
//-------------------------------------------------------------------------

//-D_NEAR_CONST_LOCATION=0
//-D_NEAR_CONST_LOCATION_START=7300
//-D_NEAR_CONST_LOCATION_END=_CODE_FLASH_END

//-------------------------------------------------------------------------
//      Size of the heaps.
//      Remove comment and modify number if used from command line.
//-------------------------------------------------------------------------

//-------------------------------------------------------------------------
//      Used by DLIB only
//      Define the format functions used by printf/scanf.
//      Default is full formatting.
//      Remove appropriate comment(s) to get reduced formatting
//      if used from command line.
//-------------------------------------------------------------------------

//-e_PrintfTiny=_Printf
//-e_PrintfSmall=_Printf
//-e_PrintfLarge=_Printf

//-e_ScanfSmall=_Scanf
//-e_ScanfLarge=_Scanf

//-------------------------------------------------------------------------
//      Used by DLIB only
//      Define if row buffering should be used by terminal output.
//      Default is no buffering.
//      Remove comment to get buffered terminal output if used from command line.
//-------------------------------------------------------------------------

//-e__write_buffered=__write

//-------------------------------------------------------------------------
//      Used by CLIB only
//      Define the format functions used by printf/scanf.
//      Default is full formatting.
//      Remove appropriate comment(s) to get reduced formatting
//      if used from command line.
//-------------------------------------------------------------------------

//-e_small_write=_formatted_write
//-e_medium_write=_formatted_write

//-e_medium_read=_formatted_read

//-------------------------------------------------------------------------
//      Allocate the read only segments that are mapped to ROM.
//-------------------------------------------------------------------------
//-------------------------------------------------------------------------
//      Interrupt vector segment.
//-------------------------------------------------------------------------
-Z(CONST)INTVEC=0000-007F
//-Z(CONST)FBL_VECT=0004-007F 	// for use with MINICUBE2 debugger
//-Z(CONST)FBL_VECT=0002-007F 	// for use without MINICUBE2 debugger
-Z(CODE)APPLVECT=7000-70FF
-Z(CONST)APPLSWHDR=7100-717F
-Z(CONST)APPLDATAHDR=7180-71FF
-Z(CONST)FBLSTART_SEG=7200-72FF 

//-------------------------------------------------------------------------
//      CALLT vector segment.
//-------------------------------------------------------------------------
-Z(CODE)CLTVEC=00080-000BD

//-------------------------------------------------------------------------
//      OPTION BYTES segment.
//-------------------------------------------------------------------------
-Z(CODE)OPTBYTE=000C0-000C3


//-------------------------------------------------------------------------
//      SECURITY_ID segment.
//-------------------------------------------------------------------------
-Z(CODE)SECUID=000C4-000CD


//-------------------------------------------------------------------------
//      Reserved ROM areas for Minicube Firmware: 000CE-000D7
//                                                17C00-17FFF
//-------------------------------------------------------------------------

//-------------------------------------------------------------------------
//      Far data segments.
//      The FAR_I and FAR_ID segments must start at the same offset
//      in a 64 Kb page.
//-------------------------------------------------------------------------
-Z(CONST)FAR_ID=[0E700-17BFF]/10000
-Z(DATA)FAR_I=[FE700-FFE1F]/10000

//-------------------------------------------------------------------------
//      Startup, Runtime-library, Near, Interrupt 
//      and CALLT functions code segment.
//-------------------------------------------------------------------------
-Z(CODE)RCODE,CODE=7300-_CODE_FLASH_END

//-------------------------------------------------------------------------
//      Data initializer segments. 
//-------------------------------------------------------------------------
-Z(CONST)NEAR_ID=[7210-_CODE_FLASH_END]/10000
-Z(CONST)SADDR_ID=[7210-_CODE_FLASH_END]/10000
-Z(CONST)DIFUNCT=[7210-_CODE_FLASH_END]/10000

//-------------------------------------------------------------------------
//      Far functions code segment.
//-------------------------------------------------------------------------
-Z(CODE)FAL_CODE=[7300-_CODE_FLASH_END]
-P(CODE)XCODE=[7210-_CODE_FLASH_END]/10000

//-------------------------------------------------------------------------
//      Constant segments 
//-------------------------------------------------------------------------
-Z(CONST)NEAR_CONST,FBLMTAB,FSL_CNST=7200-_CODE_FLASH_END
-Z(CONST)SWITCH=7210-_CODE_FLASH_END
-Z(CONST)FAL_CNST=[7300-_CODE_FLASH_END]/10000
-P(CONST)FAR_CONST,FSWITCH=[7210-_CODE_FLASH_END]/10000

//-------------------------------------------------------------------------
//      Allocate the read/write segments that are mapped to RAM.
//-------------------------------------------------------------------------

//-------------------------------------------------------------------------
//      EEPROM segment.
//      Note: This segment will not be automatically created
//            and it will not be initialised by CSTARTUP!
//-------------------------------------------------------------------------
-Z(DATA)EEPROM=E9800-ED7FF

//-------------------------------------------------------------------------
//      Short address data and workseg segments.
//-------------------------------------------------------------------------
-Z(DATA)WRKSEG=FFE20-FFEDF
-Z(DATA)SADDR_I,SADDR_Z,SADDR_N=FFE20-FFEDF
-Z(DATA)FAL_DATA=FFE20-FFEDF // Modified for NVM by CK

//-------------------------------------------------------------------------
//      Near data segments.
//-------------------------------------------------------------------------
-Z(DATA)NEAR_I,NEAR_Z,NEAR_N=FE700-FFE1F

//-------------------------------------------------------------------------
//      Far data segments.
//-------------------------------------------------------------------------
-Z(DATA)FAR_Z=[FE700-FFE1F]/10000
-P(DATA)FAR_N=[FE700-FFE1F]/10000

//-------------------------------------------------------------------------
//      Heap segments.
//-------------------------------------------------------------------------
-Z(DATA)NEAR_HEAP+_NEAR_HEAP_SIZE=FE700-FFE1F
-Z(DATA)FAR_HEAP+_FAR_HEAP_SIZE=[FE700-FFE1F]/10000

//-------------------------------------------------------------------------
//      Stack segment.
//-------------------------------------------------------------------------
-Z(DATA)CSTACK+_CSTACK_SIZE=FE700-FFE1F

//-------------------------------------------------------------------------
//      Select the output file format if used from command line.
//      Remove comment to select the file format if used from command line.
//-------------------------------------------------------------------------
//-Fdebug

//-------------------------------------------------------------------------
//      End of File
//-------------------------------------------------------------------------
